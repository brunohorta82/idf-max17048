## Kconfig.projbuild
```kconfig
menu "MAX17048" 
    config MAX17048_ACTIVE
    bool "Active"
    default n
    config MAX17048_ADDRESS
        hex
        prompt  "MAX17048 Address"
        default 0x36
        depends on MAX17048_ACTIVE
    config MAX17048_ALERT_PIN
        int "ALERT Pin"
        default 18
        depends on MAX17048_ACTIVE
    config MAX17048_INTERRUPT_PIN
        int "INTERRUPT Pin"
        default -1 
        depends on MAX17048_ACTIVE    
endmenu
```
